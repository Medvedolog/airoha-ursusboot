// SPDX-License-Identifier: (GPL-2.0-only OR BSD-2-Clause)
/dts-v1/;

#include <dt-bindings/leds/common.h>
#include <dt-bindings/gpio/gpio.h>
#include <dt-bindings/input/input.h>
#include "en7581.dtsi"

/ {
	model = "Nokia Valyrian";
	compatible = "nokia,valyrian", "airoha,an7581", "airoha,en7581";

	chosen {
		stdout-path = &uart1;
	};
};
